## app/drivers/sensor/led_sensor/Kconfig
```kconfig
config SENSOR_LED_SENSOR
	bool "LED sensor driver"
	default y
	depends on GPIO
	help
	  GPIO-backed sensor driver that turns the LED on during sample fetch
	  and off when the sensor channel is read.
```

## boards/stm32f429i_disc1_scratch/board.yml
```yaml
board:
  name: stm32f429i_disc1_scratch
  full_name: STM32F429I Discovery Scratch Board
  vendor: st
  socs:
    - name: stm32f429xx
```
